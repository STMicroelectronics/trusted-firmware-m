## platform/ext/target/stm/common/devicetree/bindings/access-controllers/access-device.yaml
```yaml
# Copyright (c) 2024, STMicroelectronics
# SPDX-License-Identifier: Apache-2.0

description: This file needs to be included by devices that need a access controller.

properties:
  access-controllers:
    type: phandle-array
    description: acces controller information

  access-controller-names:
    type: string-array
    description: Name of each reset
```

## platform/ext/target/stm/common/devicetree/bindings/clock/fixed-clock.yaml
```yaml
# Copyright (c) 2019 Derek Hageman <hageman@inthat.cloud>
# SPDX-License-Identifier: Apache-2.0

description: Generic fixed-rate clock provider

compatible: "fixed-clock"

include: clock-controller.yaml

properties:
  clock-frequency:
    type: int
    description: output clock frequency (Hz)
    required: true

  clocks:
    type: array
    description: input clock source

  "#clock-cells":
    const: 0

  st,bypass:
    description: configures the oscillator bypass mode (HSEBYP, LSEBYP)
    type: boolean
  
  st,digbypass:
    description: configures the bypass mode as full-swing digital signal (DIGBYP)
    type: boolean
  
  st,css:
    description: activates the clock security system (HSECSSON, LSECSSON)
    type: boolean
  
  st,drive:
    description: |
      only for LSE, contains the value of the drive for the oscillator
      (see LSEDRV_ defined in the file dt-bindings/clock/stm32mp13-clksrc.h)
    type: int
```

## platform/ext/target/stm/common/devicetree/bindings/cpu/arm,cortex-a35.yaml
```yaml
# Copyright (C) 2024 STMicroelectronics
# SPDX-License-Identifier: Apache-2.0

description: ARM Cortex-A35 CPU

compatible: "arm,cortex-a35"

include: cpu.yaml
```

## platform/ext/target/stm/common/devicetree/bindings/dma/st,stm32-dma3.yaml
```yaml
# Copyright (c) 2024, STMicroelectronics
# SPDX-License-Identifier: Apache-2.0

description: |
  The STM32 DMA3 is a direct memory access controller with different features
  depending on its hardware configuration.
  It is either called LPDMA (Low Power), GPDMA (General Purpose) or
  HPDMA (High Performance).

compatible: "st,stm32-dma3"

include:
  - base.yaml
  - reset-device.yaml
  - st,stm32mp25-rif.yaml

properties:
  reg:
    required: true

  clocks:
    required: true
```

## platform/ext/target/stm/common/devicetree/bindings/gpio/st,stm32-gpio.yaml
```yaml
# SPDX-License-Identifier: (GPL-2.0 OR BSD-2-Clause)
# Copyright (c) 2023, STMicroelectronics

description: |
  STMicroelectronics's STM32 MCUs intregrate a GPIO and Pin mux/config hardware
  controller. This part is focused on gpio bank configuration.

compatible: "st,stm32-gpio"

include: [gpio-controller.yaml, base.yaml]

properties:
  reg:
    required: true

  clocks:
    required: true

  "#gpio-cells":
    const: 2

  st,bank-name:
    type: string
    description:
      Should be a name string for this bank as specified in the datasheet.
    enum:
      - GPIOA
      - GPIOB
      - GPIOC
      - GPIOD
      - GPIOE
      - GPIOF
      - GPIOG
      - GPIOH
      - GPIOI
      - GPIOJ
      - GPIOK
      - GPIOZ

  st,bank-ioport:
    type: int
    description: |
      Should correspond to the EXTI IOport selection (EXTI line used
      to select GPIOs as interrupts).

gpio-cells:
  - pin
  - flags
```

## platform/ext/target/stm/common/devicetree/bindings/interrupt-controller/st,stm32mp1-exti.yaml
```yaml
# Copyright (c) 2024, STMicroelectronics
# SPDX-License-Identifier: Apache-2.0

description: |
  The extended interrupts and event controller (EXTI) manages the individual CPU and
  system wake-up through configurable and direct event inputs.

compatible: "st,stm32mp1-exti"

include:
  - base.yaml
  - interrupt-controller.yaml
  - st,stm32mp25-rif.yaml

properties:
  reg:
    required: true

  st,proccid:
    type: array
    description: |
      Applicable for platforms implementing the RIF. Used to affect the CID
      number to a particular CPU in EXTI. On STM32MP2x platforms CPU1 = A35,
      CPU2 = M33 and CPU3 = M0+. As EXTI does not know which is the CID for
      each CPU, is must be set.
      For EXTI 1, <1 RIF_CID1>, <2 RIF_CID2>;
      For EXTI 2, <1 RIF_CID1>, <2 RIF_CID2>, <3 RIF_CID3>;
```

## platform/ext/target/stm/common/devicetree/bindings/mbox/st,stm32mp25-ipcc.yaml
```yaml
# Copyright (c) 2024, STMicroelectronics
# SPDX-License-Identifier: Apache-2.0

description: STM32 IPCC MBOX

compatible: "st,stm32mp25-ipcc"

include:
  - base.yaml
  - mailbox-controller.yaml
  - st,stm32mp25-rif.yaml

properties:
  clocks:
    required: true

  interrupts:
    required: true

mbox-cells:
  - channel
```

## platform/ext/target/stm/common/devicetree/bindings/memory-controllers/st,stm32mp25-omi.yaml
```yaml
# Copyright (c) 2020 STMICROELECTRONICS
# SPDX-License-Identifier: Apache-2.0

description: |
  STM32 OSPI Memory Interface allows a SPI flash or HyperFlash connected to
  the SoC to be accessed via the external address space.

  The flash chip itself should be represented by a subnode of the STM32 OSPI
  Memory Interface node. The flash interface is selected based on the
  "compatible" property of this subnode:
  - if it contains "jedec,spi-nor", then SPI is used;
  - if it contains "spi-nand", then SPI is used.
  - if it contains "cfi-flash", then HyperFlash is used.

compatible: "st,stm32mp25-omi"

include: [base.yaml, pinctrl-device.yaml, reset-device.yaml]

properties:
  reg:
    required: true

  reg-names:
    required: true

  clocks:
    required: true

  resets:
    required: true

  pinctrl-0:
    required: true

  pinctrl-names:
    required: true
```

## platform/ext/target/stm/common/devicetree/bindings/otp/st,stm32mp25-bsec.yaml
```yaml
# Copyright (c) 2023, STMicroelectronics
# SPDX-License-Identifier: Apache-2.0

description: |
  The boot and security control (BSEC) peripheral manages the accesses to an embedded
  one time programmable (OTP) array of fuses. Those fuses are used to store on-chip,
  non-volatile data like boot and security parameters.

compatible: "st,stm32mp25-bsec"

include: [base.yaml, memory-region.yaml]

properties:
  reg:
    required: true

  memory-region:
    required: true

child-binding:
  description: |
    Each child node describes an OTP area.
    The area can look like this :

      hconf1_otp: otp124@1f0 {
        reg = <0x1f0 0x4>;
      };

  properties:
    reg:
      type: array
      description: |
        This follow the format <OFFSET SIZE> with OFFSET and SIZE in bytes.
      required: true

    shadow-provisionning:
      type: array
      description: |
        Value to provision in the shadow of the OTP.
```

## platform/ext/target/stm/common/devicetree/bindings/pinctrl/st,stm32-pinctrl.yaml
```yaml
# Copyright (c) 2023, STMicroelectronics
# SPDX-License-Identifier: Apache-2.0

description: |
    STM32 Pin controller Node
    Based on pincfg-node.yaml binding.

    Note: `bias-disable` and `drive-push-pull` are default pin configurations.
           They will be applied in case no `bias-foo` or `driver-bar` properties
           are set.

compatible: "st,stm32-pinctrl"

include: [base.yaml]

properties:
  "#gpio-range-cells":
    type: int
    const: 3

gpio-range-cells:
  - gpio_offset
  - pin_offset
  - npins

child-binding:
  description: STM32 pin controller pin group
  child-binding:
    description: STM32 pin controller pin configuration node.
    include:
      - name: pincfg-node.yaml
        property-allowlist:
          - bias-disable
          - bias-pull-down
          - bias-pull-up
          - drive-push-pull
          - drive-open-drain
          - output-low
          - output-high
          - slew-rate

    properties:
      pinmux:
        required: true
        type: array
        description: |
          Reused from
          https://github.com/torvalds/linux/blob/master/Documentation/devicetree/bindings/pinctrl/st,stm32-pinctrl.yaml
          Integer array, represents gpio pin number and mux setting.
          These defines are calculated as: ((port * 16 + line) << 8) | function
          With:
          - port: The gpio port index (PA = 0, PB = 1, ..., PK = 11)
          - line: The line offset within the port (PA0 = 0, PA1 = 1, ..., PA15 = 15)
          - function: The function number, can be:
          * 0 : Alternate Function 0
          * 1 : Alternate Function 1
          * 2 : Alternate Function 2
          * ...
          * 15 : Alternate Function 15
          * 16 : Analog
          * 17 : GPIO
          In case selected pin function is GPIO, pin is statically configured as
          a plain input/output GPIO. Default configuration is input. Output value
          can be configured by adding 'ouptut-low' or 'output-high' properties
          to the pin configuration.

          To simplify the usage, macro is available to generate "pinmux" field.
          This macro is available here:
            -include/zephyr/dt-bindings/pinctrl/stm32-pinctrl-common.h
          Some examples of macro usage:
             GPIO A9 set as alernate function 2
          ... {
                   pinmux = <STM32_PINMUX('A', 9, AF2)>;
          };
             GPIO A9 set as analog
          ... {
                   pinmux = <STM32_PINMUX('A', 9, ANALOG)>;
          };
             GPIO A9 set as GPIO output high
          ... {
                   pinmux = <STM32_PINMUX('A', 9, GPIO)>;
                   output-high;
          };

      slew-rate:
        enum: [0, 1, 2, 3]
        description: |
          Pin speed. Default to low-speed. For few pins (PA11 and
          PB3 depending on SoCs)hardware reset value could differ
          (very-high-speed). Carefully check reference manual for these pins.
```

## platform/ext/target/stm/common/devicetree/bindings/pinctrl/st,stm32mp257-pinctrl.yaml
```yaml
# Copyright (c) 2023, STMicroelectronics
# SPDX-License-Identifier: Apache-2.0

description: |
    STM32MP257 Pin controller Node
    Based on st,stm32-pinctrl.yaml binding.

compatible: "st,stm32mp257-pinctrl"

include: st,stm32-pinctrl.yaml
```

## platform/ext/target/stm/common/devicetree/bindings/regulator/st,stpmic2-regulators.yaml
```yaml
# Copyright (c) 2023, STMicroelectronics
# SPDX -License-Identifier: Apache-2.0

description: |
  STMicroelectronics STPMIC2 Power Management IC

  The PMIC has seven buck converters and eight LDOs. All need to be defined as
  children nodes, strictly following the BUCK1..7, LDO1..8 node names. For
  example:

  pmic2: stpmic2@33 {
    reg = <0x33>;
    ...
    regulators {
      compatible = "st,stpmic2-regulators";

      buck1 {
        /* all properties for buck1 */
      };
      ...
      buck7 {
        /* all properties for buck7 */
      };
      ldo1 {
        /* all properties for ldo1 */
      };
      ...
      ldo8 {
        /* all properties for ldo8 */
      };
    };
  };

compatible: "st,stpmic2-regulators"

include: base.yaml

child-binding:
  include:
    - name: regulator.yaml
      property-allowlist:
        - regulator-name
        - regulator-boot-on
        - regulator-always-on
        - regulator-min-microvolt
        - regulator-max-microvolt
        - regulator-allowed-modes
        - regulator-over-current-protection
        - regulator-enable-ramp-delay

  properties:
    st,mask-reset:
      type: boolean
      description: |
        mask reset for this regulator, the regulator configuration
        is maintained during pmic reset.

    st,regulator-bypass:
      type: boolean
      description: |
        enable bypass mode if it's available on this regulator.

    st,pwrctrl-enable:
      type: boolean
      description: |
        enable pwrctrl mode if it's available on this regulator.

    st,pwrctrl-reset:
      type: boolean
      description: |
        enable pwrctrl reset mode if it's available on this regulator.

    st,pwrctrl-sel:
      type: int
      description: |
        configure pwrctrl source selection
      enum: [0, 1, 2, 3]

    st,regulator-bypass-microvolt:
      type: int
      description: |
        regulator output voltage when configured in bypass.
        Authorize automatic bypass mode selection depending on voltage.

    st,sink-source:
      type: boolean
      description: |
        enable sink-source mode if it's available on this regulator.
```

## platform/ext/target/stm/common/devicetree/bindings/remoteproc/remoteproc-device.yaml
```yaml
# Copyright (c) 2024, STMicroelectronics
# SPDX-License-Identifier: Apache-2.0

description: This file needs to be included by devices that need a remoteproc.

properties:
  remoteprocs:
    type: phandle-array
    description: remote processor reference

  remoteproc-names:
    type: string-array
    description: Name of each remote processor
```

## platform/ext/target/stm/common/devicetree/bindings/reserved-memory/reserved-memory.yaml
```yaml
# Copyright (c) 2023, STMicroelectronics
# SPDX-License-Identifier: Apache-2.0

description: |
  Reserved memory is specified as a node under the /reserved-memory node. The
  operating system shall exclude reserved memory from normal usage one can
  create child nodes describing particular reserved (excluded from normal use)
  memory regions. Such memory regions are usually designed for the special
  usage by various device drivers.

  Each child of the reserved-memory node specifies one or more regions
  of reserved memory. Each child node may either use a 'reg' property to
  specify a specific range of reserved memory, or a 'size' property with
  optional constraints to request a dynamically allocated block of
  memory.

properties:
  reg: true
```

## platform/ext/target/stm/common/devicetree/bindings/reset/st,stm32-rcc-rctl.yaml
```yaml
# Copyright (c) 2023, STMicroelectronics
# SPDX-License-Identifier: Apache-2.0

description: |
  STM32 Reset Controller node

compatible: "st,stm32-rcc-rctl"

include: [reset-controller.yaml, base.yaml]

properties:
  "#reset-cells":
    const: 1

reset-cells:
  - id
```

## platform/ext/target/stm/common/devicetree/bindings/reset/st,stm32mp25-rcc-rctl.yaml
```yaml
# Copyright (c) 2023, STMicroelectronics
# SPDX-License-Identifier: Apache-2.0

description: |
  STM32MP25 Reset controller node

compatible: "st,stm32mp25-rcc-rctl"

include: st,stm32-rcc-rctl.yaml
```

## platform/ext/target/stm/common/devicetree/bindings/rif/st,stm32mp25-rcc-rif.yaml
```yaml
# Copyright (c) 2023, STMicroelectronics
# SPDX-License-Identifier: Apache-2.0

description: |
  the RCC implements the following security/isolation requirements which apply
  to any defined security domain:
    - filtering of secure/non-secure accesses
    - filtering of privileged/unprivileged accesses
    - filtering of hardware execution compartments (CIDs)

compatible: "st,stm32mp25-rcc-rif"

include:
  - base.yaml
  - access-controller.yaml
  - st,stm32mp25-rif.yaml

properties:
  "#access-controller-cells":
    const: 1

access-controller-cells:
  - protreg
```

## platform/ext/target/stm/common/devicetree/bindings/rif/st,stm32mp25-rif.yaml
```yaml
# Copyright (c) 2023, STMicroelectronics
# SPDX -License-Identifier: Apache-2.0

properties:
  st,protreg:
    type: array
    description: |
      protection value of rif peripherals, each entry is defined by a 32 bit.
```
