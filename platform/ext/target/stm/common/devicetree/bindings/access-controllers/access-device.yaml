## platform/ext/target/stm/common/devicetree/bindings/rif/st,stm32mp25-rifsc.yaml
```yaml
# Copyright (c) 2023, STMicroelectronics
# SPDX-License-Identifier: Apache-2.0

description: |
  Resource isolation framework (RIF) is a comprehensive set of hardware blocks
  designed to enforce and manage isolation of STM32 hardware resources like
  memory and peripherals.

  The RIFSC (RIF security controller) is composed of three sets of registers,
  each managing a specific set of hardware resources:
    - RISC registers associated with RISUP logic (resource isolation device unit
      for peripherals), assign all non-RIF aware peripherals to zero, one or
      any security domains (secure, privilege, compartment).
    - RIMC registers: associated with RIMU logic (resource isolation master
      unit), assign all non RIF-aware bus master to one security domain by
      setting secure, privileged and compartment information on the system bus.
      Alternatively, the RISUP logic controlling the device port access to a
      peripheral can assign target bus attributes to this peripheral master port
      (supported attribute: CID).
    - RISC registers associated with RISAL logic (resource isolation device unit
      for address space - Lite version), assign address space subregions to one
      security domains (secure, privilege, compartment).

compatible: "st,stm32mp25-rifsc"

include:
  - base.yaml
  - access-controller.yaml
  - st,stm32mp25-rif.yaml

properties:
  reg:
    required: true

  "#access-controller-cells":
    const: 1

  st,rimu:
    type: array
    description:
      protection value of rif master port, each entry is defined by a 32 bit.

access-controller-cells:
  - protreg
```

## platform/ext/target/stm/common/devicetree/bindings/rif/st,stm32mp25-risab.yaml
```yaml
# Copyright (c) 2023, STMicroelectronics
# SPDX -License-Identifier: Apache-2.0

description: |
  The RIF (resource isolation framework) is a comprehensive set of hardware
  blocks designed to enforce and manage isolation of STM32 hardware resources,
  like memory and peripherals.
  Through RISAB registers, a trusted domain application, or the application to
  whom the page configuration has been delegated, assigns memory pages to one or
  more security domains (secure, privilege, compartment).

compatible: "st,stm32mp25-risab"

include: [base.yaml, memory-region.yaml]

properties:
  reg:
    required: true

  clocks:
    required: true

  memory-region:
    required: true

  st,srwiad:
    type: boolean
    description: |
      When set, this bit allows secure read/write data accesses to non-secure
      blocks and pages (secure execute remains illegal).
```

## platform/ext/target/stm/common/devicetree/bindings/rif/st,stm32mp25-risaf-enc.yaml
```yaml
# Copyright (c) 2023, STMicroelectronics
# SPDX -License-Identifier: Apache-2.0

description: |
        RISAF (enc:encode) managing DRR includes the DDR memory cipher engine (DDRMCE) feature.

compatible: "st,stm32mp25-risaf-enc"

include: st,stm32mp25-risaf.yaml
```

## platform/ext/target/stm/common/devicetree/bindings/rif/st,stm32mp25-risaf.yaml
```yaml
# Copyright (c) 2023, STMicroelectronics
# SPDX -License-Identifier: Apache-2.0

description: |
  The RIF (resource isolation framework) is a comprehensive set of hardware
  blocks designed to enforce and manage isolation of STM32 hardware resources,
  like memory and peripherals.
  Through RISAF registers, a trusted domain application, or the application to
  whom the configuration has been delegated, assigns memory regions and
  subregions to one or more security domains (secure, privilege, compartment).
  RISAF managing DRR includes the DDR memory cipher engine (DDRMCE) feature.

compatible: "st,stm32mp25-risaf"

include: [base.yaml, memory-region.yaml]

properties:
  reg:
    required: true

  clocks:
    required: true

  memory-region:
    required: true

  st,mem-map:
    type: array
    description: |
      Defines the memory range covered by the RISAF.
```

## platform/ext/target/stm/common/devicetree/bindings/rtc/st,stm32mp25-rtc.yaml
```yaml
# Copyright (c) 2024, STMicroelectronics
# SPDX-License-Identifier: Apache-2.0

description: STMicroelectronics STM32 RTC

compatible: "st,stm32mp25-rtc"

include:
  - base.yaml
  - st,stm32mp25-rif.yaml

properties:
  reg:
    required: true

  clocks:
    required: true
```

## platform/ext/target/stm/common/devicetree/bindings/scmi/scmi-agent.yaml
```yaml
# Copyright (c) 2024, STMicroelectronics
# SPDX-License-Identifier: Apache-2.0

description: This file needs to be included to define an scmi agent
properties:
  agent-id:
    type: int
    description: Agent id number , agent 0 is reserved for cortex A, agent 1 is for non secure
  agent-name:
    type: string
    description: Agent Name
```

## platform/ext/target/stm/common/devicetree/bindings/scmi/scmi-clk-list.yaml
```yaml
# Copyright (c) 2024, STMicroelectronics
# SPDX-License-Identifier: Apache-2.0

# Scmi reset list
properties:
  clk-list:
    type: phandles
    description: List of clk scmi phandles
  clk-id-max:
    type: int
    description: highest id in clk list
```
