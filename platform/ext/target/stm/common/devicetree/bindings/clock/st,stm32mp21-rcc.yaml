## platform/ext/target/stm/common/devicetree/bindings/clock/st,stm32mp21-rcc.yaml
```yaml
# Copyright (c) 2023, STMicroelectronics
# SPDX-License-Identifier: Apache-2.0

description: |
  STM32MP21 RCC node.

compatible: "st,stm32mp21-rcc"

include: st,stm32mp25-rcc.yaml
```

## platform/ext/target/stm/common/devicetree/bindings/crypto/st,stm32mp21-saes.yaml
```yaml
# SPDX-License-Identifier: (GPL-2.0-only OR BSD-2-Clause)
# Copyright (c) 2025, STMicroelectronics

description: |
  The secure AES coprocessor (SAES) embedded in STM32MP21 SoC inherits of the
  features described in st,stm32mp13-saes.yaml. In this version, support for
  192-bit key sizes has been introduced, in addition to the existing 128-bit and
  256-bit key sizes.

compatible: "st,stm32mp21-saes"

include:
  - st,stm32mp13-saes.yaml
```

## platform/ext/target/stm/common/devicetree/bindings/mbox/st,stm32mp21-dbgmcu-mbx.yaml
```yaml
# Copyright (c) 2025, STMicroelectronics
# SPDX-License-Identifier: Apache-2.0

description: |
  On STM32MP21, the debug authentication protocol implements a bidirectional
  communication between the debugger (host) and the target (STM32MP21) through
  a mailbox interface located in the DBGMCU.

compatible: "st,stm32mp21-dbgmcu-mbx"

include:
  - base.yaml
  - entropy-device.yaml

properties:
  reg:
    required: true

  clocks:
    required: true

  interrupts:
    required: true

  interrupt-names:
    type: string-array
    description: |
      - "dbg_auth_wr" Detection of debugger write in DBG_AUTH_HOST register,
      - "dbg_auth_rd" Detection of debugger read DBG_AUTH_DEV register.
```

## platform/ext/target/stm/common/devicetree/bindings/nvmem/nvmem-consumer.yaml
```yaml
# Copyright (c) 2025, STMicroelectronics
# SPDX-License-Identifier: Apache-2.0

properties:
  nvmem-cells:
    type: phandle-array
    description: Non-volatile memory cells
    specifier-space: nvmem-cell

  nvmem-cell-names:
    type: string-array
    description: Provided names of non-volatile memory cells
```

## platform/ext/target/stm/common/devicetree/bindings/power/st,stm32mp25-pwr.yaml
```yaml
# Copyright (c) 2024, STMicroelectronics
# SPDX-License-Identifier: Apache-2.0

description: |
  STMicroelectronics power control (PWR) provides an overview of the supply
  architecture of the different power domains, and the control
  of the supply configuration.

compatible: "st,stm32mp25-pwr"

include:
  - base.yaml
  - reset-device.yaml
  - st,stm32mp25-rif.yaml
  - access-controller.yaml
  - name: st,stm32mp25-syscfg-properties.yaml
    property-allowlist:
      - st,syscfg-vddio

properties:
  reg:
    required: true

  resets:
    required: true
    description: |
      backup domain reset

  "#access-controller-cells":
    const: 1

access-controller-cells:
  - protreg

child-binding:
  compatible: "st,stm32mp25-pwr-regu"

  include:
    - base.yaml
    - power.yaml
    - name: regulator.yaml
      property-allowlist:
        - regulator-name
        - regulator-boot-on
        - regulator-always-on
        - regulator-min-microvolt
        - regulator-max-microvolt
        - regulator-allowed-modes
        - regulator-over-current-protection
        - regulator-ramp-delay
        - regulator-enable-ramp-delay

  properties:
    vin-supply:
      type: phandle
      description: Reference to the regulator supply

    st,iocomp:
      type: array
      description: |
        Defines the pmos and nmos value for an IO domain.
        For STM32MP2x platforms, it corresponds to <pmos nmos>

    st,popl-d1-ms:
      type: int
      description: |
        PWR_CPU_ON pulse low configuration (PWR_D1CR)

    st,podh-d2-ms:
      type: int
      description: |
        PWR_ON delay high configuration (PWR_D2CR)

    st,popl-d2-ms:
      type: int
      description: |
        PWR_ON pulse low configuration (PWR_D2CR)

    st,lpcfg-d2:
      type: int
      description: |
        PWR_ON pin configuration (PWR_D2CR)

    st,lplvdly-d2:
      type: int
      description: |
        LPLV delay value (PWR_D2CR), 3bits and with 6xLSI cycles unit
        (0:187 μs... 111:1.5 ms)
```

## platform/ext/target/stm/common/devicetree/bindings/psa_mbox/st,psa-mbox.yaml
```yaml
# Copyright (c) 2024, STMicroelectronics
# SPDX-License-Identifier: Apache-2.0

description: psa mailbox consumer
compatible: "st,psa-mbox"

include:
  - base.yaml
  - memory-region.yaml

properties:
  mboxes:
    required: true
  mbox-names:
    required: false
  memory-region:
    required: true
```

## platform/ext/target/stm/common/devicetree/bindings/regulator/st,stpmic.yaml
```yaml
# Copyright (c) 2026, STMicroelectronics
# SPDX-License-Identifier: Apache-2.0

description: |
  STMicroelectronics Power Management Integrated Circuit (PMIC)

include:
  - base.yaml
  - interrupt-controller.yaml

properties:
  "#interrupt-cells":
    const: 1

  system-power-controller:
     type: boolean
     description: This indicates that STPMIC is the power supply master of the
       system. With this flag, the driver will initiate an software switch OFF
       for system poweroff.

interrupt-cells:
  - irq
```

## platform/ext/target/stm/common/devicetree/bindings/regulator/st,stpmic1l.yaml
```yaml
# Copyright (c) 2025, STMicroelectronics
# SPDX -License-Identifier: Apache-2.0

description: |
  STMicroelectronics Power Management IC (PMIC) STPMIC1L

  The STPMIC1L has two buck converters, four LDOs and five GPOs.
  All need to be defined as children of regulators node, with node names:
  buck2..5, ldo1..7 and gpo1..2 nodes
  see st,stpmic2-regulators.yaml for reguators bindings

  stpmic1l: pmic@33 {
    compatible = "st,stpmic1l";
    reg = <0x33>;
    ...
    regulators {
      compatible = "st,stpmic2-regulators";

      buck1 {
      };
      ...
      buck2 {
      };
      ldo2 {
      };
      ...
      ldo5 {
      };
      gpo1 {
      };
      ...
      gpo2 {
      };
    };
  };

compatible: "st,stpmic1l"
```

## platform/ext/target/stm/common/devicetree/bindings/remoteproc/rproc-srm-core.yaml
```yaml
# Copyright (c) 2026, STMicroelectronics
# SPDX-License-Identifier: Apache-2.0

description: |
  This document defines the binding for the remoteproc resource
  manager component

compatible: "rproc-srm-core"

include:
  - base.yaml
  - reset-device.yaml
  - access-device.yaml

child-binding:

  description: |
    a child describes peripheral resource to be reset at remote proc stop.
    It provides the RIF access control to set, the clock to enable, the voltage
    supply conditioning the reset and the resets to perform.

  include:
     - reset-device.yaml
     - access-device.yaml
  properties:
    clocks:
      type: phandle-array
      description: Clock gate information
    vin-supply:
      description: |
        Reference to the regulator that controls power to the device.
        It is conditioning reset if enabled.
      type: phandle
```

## platform/ext/target/stm/common/devicetree/bindings/remoteproc/st,stm32mp2-a35.yaml
```yaml
# Copyright (c) 2024, STMicroelectronics
# SPDX-License-Identifier: Apache-2.0

description: |
  This document defines the binding for the remoteproc component that
  boots firmwares on the ST32MP2 family chipset.

compatible: "st,stm32mp2-a35"

include:
  - base.yaml
  - reset-device.yaml
  - access-device.yaml
  - nvmem-consumer.yaml

properties:
  resets:
    required: true

  clocks:
    description: The clocks to be restore after boot.

  interrupt-names:
    description: |
      - "ack" interrupt generated by a35 remote processor at bootime.

  regus:
    description: regulator phandles.
    type: phandles
```

## platform/ext/target/stm/common/devicetree/bindings/remoteproc/tfm,rproc.yaml
```yaml
# Copyright (c) 2026, STMicroelectronics
# SPDX-License-Identifier: Apache-2.0

description: |
  The remoteproc component boots co-processor via TF-M ioctl CPU interface.

compatible: "tfm,rproc"

include:
  - base.yaml

properties:
  tfm,cpu-id:
    type: int
    required: true
    description: |
      processor id controlled by TF-M ioctl CPU.

  interrupt-names:
    description: |
      - "wdog" interrupt generated by co-processor watchdog to report a crash.
```

## platform/ext/target/stm/common/devicetree/bindings/reset/st,stm32mp25-hpdma-reset.yaml
```yaml
# Copyright (c) 2026, STMicroelectronics
# SPDX-License-Identifier: Apache-2.0

description: |
  STM32 HPDMA Reset node.
  This node is in charge of hpdma channel reset.

compatible: "st,stm32mp25-hpdma-reset"

include: [reset-controller.yaml, base.yaml]

properties:
  "#reset-cells":
    const: 1

reset-cells:
  - id
```

## platform/ext/target/stm/common/devicetree/bindings/scmi/st,stm32mp2-scmi.yaml
```yaml
# Copyright (c) 2024 STMicroelectronics
# SPDX-License-Identifier: Apache-2.0

description: |
  STM32 SCMI configuration server

compatible: "st,stm32mp2-scmi"

include:
  - base.yaml
  - scmi-agent.yaml
  - scmi-rst-list.yaml
  - scmi-clk-list.yaml
  - scmi-regu-list.yaml
  - scmi-pd-list.yaml
  - memory-region.yaml

properties:

  agent-id:
    required: true

  agent-name:
    required: true

  memory-region:
    required: false

  mboxes:
    required: false

  rst-list:
    required: false

  rst-id-max:
    required: false

  clk-list:
    required: false

  clk-id-max:
    required: false

  regu-list:
    required: false

  regu-id-max:
    required: false

  pd-list:
    required: false

  pd-id-max:
    required: false
```

## platform/ext/target/stm/common/devicetree/bindings/scmi/st,stm32mp25-scmi-pd.yaml
```yaml
# Copyright (c) 2023, STMicroelectronics
# SPDX-License-Identifier: Apache-2.0

description: |
  Define a pd service exported by scmi

compatible: "st,stm32mp25-scmi-pd"
include:
  - base.yaml
  - access-device.yaml
  - scmi-id.yaml

properties:
  clocks:
    required: true

  regu:
    type: phandle
    required: true

  access-controllers:
    description: |
      For gpu power domain, the cid filtering must be disabled to access
      at regulator gpu and pll3 clock (PWR_CR12, cf errata section 2 3 5).

  scmi-id:
    required: true
```

## platform/ext/target/stm/common/devicetree/bindings/syscon/st,stm32mp21-syscfg.yaml
```yaml
# SPDX-License-Identifier: (GPL-2.0-only OR BSD-2-Clause)
# Copyright (c) 2025, STMicroelectronics

description: |
  STM32 System configuration controller (SYSCFG) in STM32MP21 SoC inherits of
  the features described in st,stm32mp25-syscfg.yaml. This version support less
  registers.

compatible: "st,stm32mp21-syscfg"

include:
  - st,stm32mp25-syscfg.yaml
```

## platform/ext/target/stm/common/devicetree/bindings/watchdog/st,stm32mp13-iwdg.yaml
```yaml
# Copyright (c) 2025, STMicroelectronics - All Rights Reserved
# SPDX-License-Identifier: Apache-2.0

compatible: "st,stm32mp13-iwdg"

include: st,stm32mp1-iwdg.yaml
```
