## platform/ext/target/stm/common/devicetree/bindings/scmi/scmi-id.yaml
```yaml
# Copyright (c) 2024, STMicroelectronics
# SPDX-License-Identifier: Apache-2.0

description: This file needs to be included to define a service exported by scmi
properties:
  scmi-id:
    type: int
    description: Fix the id used by remote to reach the scmi service
```

## platform/ext/target/stm/common/devicetree/bindings/scmi/scmi-pd-list.yaml
```yaml
# Copyright (c) 2024, STMicroelectronics
# SPDX-License-Identifier: Apache-2.0

# SCMI pd list
properties:
  pd-list:
    type: phandles
    description: List of SCMI power domain
  pd-id-max:
    type: int
    description: highest id in pd list
```

## platform/ext/target/stm/common/devicetree/bindings/scmi/scmi-regu-list.yaml
```yaml
# Copyright (c) 2024, STMicroelectronics
# SPDX-License-Identifier: Apache-2.0

# Scmi regu list
properties:
  regu-list:
    type: phandles
    description: List of regu scmi phandles
  regu-id-max:
    type: int
    description: highest id in regu list
```

## platform/ext/target/stm/common/devicetree/bindings/scmi/scmi-rst-list.yaml
```yaml
# Copyright (c) 2024, STMicroelectronics
# SPDX-License-Identifier: Apache-2.0

# Scmi clk list
properties:
  rst-list:
    type: phandles
    description: List of rst scmi phandles
  rst-id-max:
    type: int
    description: highest id in rst list
```

## platform/ext/target/stm/common/devicetree/bindings/scmi/st,stm32mp25-scmi-clk.yaml
```yaml
# Copyright (c) 2023, STMicroelectronics
# SPDX-License-Identifier: Apache-2.0

description: |
  Define a clock service exported by scmi

compatible: "st,stm32mp25-scmi-clk"
include:
  - base.yaml
  - scmi-id.yaml

properties:
  clocks:
    required: true
  rate:
    type: boolean
    description: when true, it enables rate support
  scmi-id:
    required: true
```

## platform/ext/target/stm/common/devicetree/bindings/scmi/st,stm32mp25-scmi-regu.yaml
```yaml
# Copyright (c) 2023, STMicroelectronics
# SPDX-License-Identifier: Apache-2.0

description: |
  Define a regulator service exported by scmi

compatible: "st,stm32mp25-scmi-regu"
include:
  - base.yaml
  - scmi-id.yaml

properties:
  regu:
    type: phandle
    required: true

  scmi-id:
    required: true
```

## platform/ext/target/stm/common/devicetree/bindings/scmi/st,stm32mp25-scmi-rst.yaml
```yaml
# Copyright (c) 2024, STMicroelectronics
# SPDX-License-Identifier: Apache-2.0

description: |
  Define a reset service exported by scmi

compatible: "st,stm32mp25-scmi-rst"
include:
  - base.yaml
  - reset-device.yaml
  - scmi-id.yaml

properties:
  resets:
    required: true

  reset-names:
    required: true

  scmi-id:
    required: true
```

## platform/ext/target/stm/common/devicetree/bindings/scp/st,scp-mbox.yaml
```yaml
# Copyright (c) 2024, STMicroelectronics
# SPDX-License-Identifier: Apache-2.0

description: scp mailbox consumer
compatible: "st,scp-mbox"

include: base.yaml

properties:
  mboxes:
    required: true
  mbox-names:
    required: true
```

## platform/ext/target/stm/common/devicetree/bindings/serial/st,stm32-uart-base.yaml
```yaml
# Copyright (c) 2020 STMICROELECTRONICS
# SPDX-License-Identifier: Apache-2.0

# Common fields for STM32 UART peripherals.
description: STM32 UART-BASE

include: [uart-controller.yaml, pinctrl-device.yaml, reset-device.yaml]

properties:
  reg:
    required: true

  clocks:
    required: true

  pinctrl-0:
    required: true

  pinctrl-names:
    required: true
```

## platform/ext/target/stm/common/devicetree/bindings/serial/st,stm32-uart.yaml
```yaml
# Copyright (c) 2023, STMicroelectronics
# SPDX-License-Identifier: Apache-2.0

description: STM32 UART

compatible: "st,stm32h7-uart"

include: st,stm32-uart-base.yaml
```

## platform/ext/target/stm/common/devicetree/bindings/serial/st,stm32h7-uart.yaml
```yaml
# SPDX-License-Identifier: (GPL-2.0 OR BSD-2-Clause)
# Copyright (c) 2023, STMicroelectronics

description: STMicroelectronics STM32 UART

compatible: "st,stm32h7-uart"

include:
  - name: base.yaml
  - name: reset-device.yaml
  - name: pinctrl-device.yaml
  - name: uart-controller.yaml
    property-allowlist:
      - current-speed

properties:
  reg:
    required: true

  clocks:
    required: true

  pinctrl-0:
    required: true

  pinctrl-names:
    required: true
```

## platform/ext/target/stm/common/devicetree/bindings/syscon/st,stm32mp25-syscfg-properties.yaml
```yaml
# Copyright (c) 2023, STMicroelectronics
# SPDX-License-Identifier: Apache-2.0

description: stm32 system configuration properties

properties:

  st,syscfg-dlyb:
    type: phandle-array
    specifier-space: syscfg-reg
    description: |
      Use to set the OSPI delay block within SYSCFG to:
        - Tune the phase of the RX sampling clock (or DQS) in order
        to sample the data in their valid window.
        - Tune the phase of the TX launch clock in order to meet setup
        and hold constraints of TX signals versus the memory clock.

  st,syscfg-safe-reset:
    type: phandle-array
    specifier-space: syscfg-reg-mask
    description: enable syscfg safe reset connector if defined

  st,syscfg-amcr:
    type: phandle-array
    specifier-space: syscfg-reg-mask
    description: The Address Mapping Control Register (AMCR) is used
      to split the 256MB memory map area shared between the 2 OSPI
      Memory Interface (OMI). The Octo Memory Manager sets the AMCR
      depending of the memory-region configuration.
```

## platform/ext/target/stm/common/devicetree/bindings/syscon/st,stm32mp25-syscfg.yaml
```yaml
# Copyright (c) 2023, STMicroelectronics
# SPDX-License-Identifier: Apache-2.0

description: |
  STM32 System configuration controller (SYSCFG) node.

compatible: "st,stm32mp25-syscfg"

include: [syscon.yaml]

properties:

  "#syscfg-reg-cells":
    type: int
    const: 1

  "#syscfg-reg-mask-cells":
    type: int
    const: 2

syscfg-reg-cells:
  - offset

syscfg-reg-mask-cells:
  - offset
  - mask
```

## platform/ext/target/stm/common/devicetree/bindings/tamper/st,stm32-tamp.yaml
```yaml
# Copyright (c) 2024, STMicroelectronics
# SPDX-License-Identifier: Apache-2.0

description: |
  The anti-tamper detection circuit is used to protect sensitive data from
  external attacks. 128 32-bit backup registers are retained in all low-power
  modes and also in V BAT mode.

compatible: "st,stm32-tamp"

include:
  - base.yaml

properties:
  reg:
    required: true

  clocks:
    required: true
```

## platform/ext/target/stm/common/devicetree/bindings/tamper/st,stm32mp25-tamp.yaml
```yaml
# Copyright (c) 2024, STMicroelectronics
# SPDX-License-Identifier: Apache-2.0

description: |
  The anti-tamper detection circuit is used to protect sensitive data from
  external attacks. 128 32-bit backup registers are retained in all low-power
  modes and also in V BAT mode.

compatible: "st,stm32mp25-tamp"

include:
  - st,stm32-tamp.yaml
  - st,stm32mp25-rif.yaml

properties:
  st,backup-zones:
    type: array
    required: true
    description: |
      Defines the topology of the backup registers zones
      For STM32MP2x platforms, it corresponds to
      <zone1-rif1 zone1-rif2 zone2-rif1 zone2-rif2 zone3-rif1 zone3-rif0 zone3-rif2>;
```
