// SPDX-License-Identifier: (GPL-2.0-only OR BSD-3-Clause)
/*
 * Copyright (C) STMicroelectronics 2025 - All Rights Reserved
 *
 * This file allows to overwrite stm32mp23xc.dtsi to change secure reg
 * properties by non secure value (for soc devices)
 */

#include "stm32mp23xc.dtsi"
