// SPDX-License-Identifier: (GPL-2.0-only OR BSD-3-Clause)
/*
 * Copyright (C) STMicroelectronics 2023 - All Rights Reserved
 */
#include "stm32mp253.dtsi"

/ {
};

&a35_rproc_srm {
	a35_gpu: a35_gpu@0 {
		resets = <&rcc_reset GPU_R>;
		clocks = <&rcc CK_SCMI_PLL3>;
		status = "disabled";
	};
};
