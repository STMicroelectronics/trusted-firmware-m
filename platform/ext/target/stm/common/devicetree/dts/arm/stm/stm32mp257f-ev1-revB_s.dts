// SPDX-License-Identifier: (GPL-2.0-or-later OR BSD-3-Clause)
/*
 * Copyright (C) STMicroelectronics 2023 - All Rights Reserved
 */

/dts-v1/;

#include "stm32mp257f-ev1_s.dts"

/ {
	model = "STMicroelectronics STM32MP257F-EV1 Evaluation Board cut1.1";
	compatible = "st,stm32mp257f-ev1", "st,stm32mp257";
};
